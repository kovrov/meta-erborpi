## meta-rpi/conf/layer.conf
```bitbake
# We have a conf and classes directory, add to BBPATH
BBPATH .= ":${LAYERDIR}"

# We have recipes-* directories, add to BBFILES
BBFILES += "\
    ${LAYERDIR}/recipes-*/*/*.bb \
    ${LAYERDIR}/recipes-*/*/*.bbappend"

BBFILE_COLLECTIONS += "erborpi-rpi"
BBFILE_PATTERN_erborpi-rpi = "^${LAYERDIR}/"
BBFILE_PRIORITY_erborpi-rpi = "10"

LAYERDEPENDS_erborpi-rpi = "erborpi raspberrypi"
```
